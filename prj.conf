## CMakeLists.txt
```
cmake_minimum_required(VERSION 3.20.0)

find_package(Zephyr REQUIRED HINTS $ENV{ZEPHYR_BASE})
project(hello_world)

# These samples use local static initialization. Since Zephyr doesn't support the
# C++ ABI for thread-safe initialization of local statics and the constructors don't
# appear to require thread safety, we turn it off in the C++ compiler.
set(NO_THREADSAFE_STATICS $<TARGET_PROPERTY:compiler-cpp,no_threadsafe_statics>)
zephyr_compile_options($<$<COMPILE_LANGUAGE:CXX>:${NO_THREADSAFE_STATICS}>)

file(GLOB app_sources src/*)
target_sources(app PRIVATE ${app_sources})
```

## sample.yaml
```
sample:
  description: CIFAR-10 TensorFlow sample
  name: CIFAR-10 tensorflow
common:
  tags: tensorflow
  modules:
    - tflite-micro
  harness: console
  harness_config:
    type: multi_line
    ordered: false
    regex:
      - "x_value:.*, y_value:.*"
      - ""
tests:
  sample.tensorflow.helloworld:
    platform_allow:
      - qemu_x86
      - qemu_x86_64
    integration_platforms:
      - qemu_x86
    tags: tensorflow
    filter: CONFIG_FULL_LIBC_SUPPORTED
  sample.tensorflow.helloworld.cmsis_nn:
    tags: tensorflow
    platform_allow: mps3_an547
    extra_configs:
      - CONFIG_TENSORFLOW_LITE_MICRO_CMSIS_NN_KERNELS=y
```

## prj.conf
```kconfig
# Copyright 2019 The TensorFlow Authors. All Rights Reserved.
#
# Licensed under the Apache License, Version 2.0 (the "License");
# you may not use this file except in compliance with the License.
# You may obtain a copy of the License at
#
#    http://www.apache.org/licenses/LICENSE-2.0
#
# Unless required by applicable law or agreed to in writing, software
# distributed under the License is distributed on an "AS IS" BASIS,
# WITHOUT WARRANTIES OR CONDITIONS OF ANY KIND, either express or implied.
# See the License for the specific language governing permissions and
# limitations under the License.
# ==============================================================================s
CONFIG_CPP=y
CONFIG_STD_CPP17=y
CONFIG_TENSORFLOW_LITE_MICRO=y
CONFIG_MAIN_STACK_SIZE=2048
CONFIG_SERIAL=y
CONFIG_UART_CONSOLE=y
CONFIG_LOG=y
CONFIG_REQUIRES_FULL_LIBC=y
CONFIG_TENSORFLOW_LITE_MICRO_CMSIS_NN_KERNELS=y
```

## src/main.c
```c
/*
 * Copyright 2020 The TensorFlow Authors. All Rights Reserved.
 *
 * Licensed under the Apache License, Version 2.0 (the "License");
 * you may not use this file except in compliance with the License.
 * You may obtain a copy of the License at
 *
 *     http://www.apache.org/licenses/LICENSE-2.0
 *
 * Unless required by applicable law or agreed to in writing, software
 * distributed under the License is distributed on an "AS IS" BASIS,
 * WITHOUT WARRANTIES OR CONDITIONS OF ANY KIND, either express or implied.
 * See the License for the specific language governing permissions and
 * limitations under the License.
 */

#include "main_functions.h"
#include <zephyr/kernel.h>
#include <zephyr/drivers/gpio.h>

int main(int argc, char *argv[])
{
	setup();
	while (1)
	{
		loop();
	}
return 0;
}
```

## src/input.hpp
```c
uint8_t g_test[] = 
{
106,106,106,102,102,102,103,103,103,103,103,103,
103,103,103,103,103,103,103,103,103,103,103,103,
103,103,103,103,103,103,104,104,104,104,104,104,
104,104,104,104,104,104,104,104,104,104,103,104,
104,102,104,103,102,104,102,104,104,101,104,103,
103,103,105,103,102,105,103,103,103,104,104,101,
103,104,102,104,104,104,103,103,103,103,103,103,
103,103,103,104,104,104,104,104,104,103,103,103,
109,109,109,106,106,106,106,106,106,106,106,106,
106,106,106,106,106,106,106,106,106,106,106,106,
106,106,106,106,106,106,107,107,107,107,107,107,
107,107,107,107,107,107,107,107,107,107,107,107,
108,105,104,107,105,104,107,107,105,105,107,105,
105,106,108,105,105,109,106,107,108,107,107,106,
107,107,105,107,107,107,106,106,106,106,106,106,
106,106,106,107,107,107,107,107,107,106,106,106,
108,108,108,105,105,105,105,105,105,105,105,105,
105,105,105,105,105,105,105,105,105,105,105,105,
105,105,105,105,105,105,105,105,105,105,105,105,
105,105,105,105,105,105,106,106,106,106,105,105,
107,104,102,107,105,102,106,106,105,105,106,107,
98,101,104,102,106,109,102,104,106,105,105,105,
105,105,105,105,105,105,105,105,105,105,105,105,
105,105,105,106,106,106,106,106,106,105,105,105,
109,109,109,106,106,106,106,106,106,106,106,106,
106,106,106,106,106,106,106,106,106,106,106,106,
105,105,105,105,105,105,105,105,105,105,105,105,
105,105,105,105,105,105,106,106,106,106,106,105,
104,104,101,103,103,102,99,101,103,94,97,102,
57,63,68,80,87,90,78,81,84,99,99,101,
107,106,106,105,105,105,105,105,105,105,105,105,
105,105,105,106,106,106,106,106,106,106,106,106,
108,108,108,105,105,105,106,106,106,106,106,106,
106,106,106,106,106,106,106,106,106,106,106,106,
105,105,105,105,105,105,106,106,106,106,106,106,
105,105,105,105,105,105,106,106,106,106,106,106,
107,109,107,104,108,108,90,96,101,74,81,90,
34,43,50,66,76,79,85,89,92,101,100,103,
108,106,108,106,106,106,106,106,106,106,106,106,
106,107,107,107,107,107,107,107,107,107,107,107,
110,110,109,107,106,106,107,106,106,107,106,106,
107,106,106,107,106,106,106,107,106,106,106,106,
105,105,105,106,106,106,108,107,107,108,107,107,
105,106,107,103,104,105,106,108,108,100,102,103,
79,87,89,65,76,81,56,69,78,45,59,71,
36,50,60,55,67,73,78,86,91,97,99,103,
107,106,108,107,107,106,107,107,106,107,107,106,
107,107,107,108,108,108,108,108,108,108,108,108,
99,100,100,99,98,99,103,101,102,102,99,101,
105,103,104,108,107,107,108,108,106,107,108,106,
108,106,107,108,106,107,110,107,108,110,108,109,
96,100,101,95,99,100,104,108,109,92,97,99,
54,68,75,32,51,61,30,51,62,25,47,61,
15,34,48,14,30,42,27,40,48,69,77,82,
104,109,110,107,108,105,106,107,104,106,106,106,
106,107,107,107,109,108,108,108,108,110,108,109,
83,91,93,95,101,104,101,105,109,98,103,105,
100,105,105,105,108,107,108,109,106,109,108,107,
110,108,109,110,108,109,110,107,108,111,109,110,
72,75,74,90,93,92,104,107,106,85,89,89,
64,75,81,56,72,81,55,72,82,44,62,74,
36,53,67,30,45,58,33,47,56,57,70,75,
100,110,111,105,110,109,104,109,108,104,109,109,
105,110,109,107,110,109,108,110,109,109,109,109,
87,105,112,92,107,114,96,109,117,96,110,114,
98,111,111,102,109,108,107,108,106,109,107,106,
109,107,108,109,107,108,108,108,108,110,110,110,
68,69,67,91,92,89,104,105,102,101,102,100,
80,84,88,80,87,93,90,99,106,79,89,98,
80,92,105,81,95,106,88,104,111,89,106,112,
96,111,114,99,109,111,99,110,111,101,111,111,
101,111,110,106,111,110,108,111,110,109,109,109,
246,11,20,247,9,19,252,13,24,7,26,32,
43,59,62,96,105,104,106,107,104,108,105,103,
107,104,105,106,106,106,106,108,107,104,108,106,
85,87,85,97,99,97,103,105,103,107,108,107,
99,101,103,98,101,106,102,107,112,96,103,110,
96,108,118,88,104,114,72,90,97,56,75,82,
43,60,66,38,50,57,38,51,56,57,70,72,
94,106,106,106,112,110,107,111,110,109,111,110,
237,1,12,231,249,4,236,253,8,239,255,8,
17,30,36,93,100,102,98,99,96,100,97,95,
107,103,104,105,105,105,102,107,105,101,108,106,
100,105,106,102,106,107,103,108,109,101,106,107,
102,107,109,102,108,111,100,108,112,94,103,109,
62,77,84,35,55,62,17,36,43,8,27,34,
5,20,30,0,11,24,249,4,14,20,33,37,
87,99,100,105,112,110,106,111,109,108,111,110,
66,83,95,59,73,86,70,82,95,71,82,94,
80,88,98,94,98,102,84,84,82,82,80,77,
87,84,85,91,93,93,90,97,96,81,92,90,
80,90,94,82,92,96,87,96,101,91,100,104,
96,105,108,97,107,110,96,108,112,89,102,108,
54,75,79,46,69,74,52,71,78,49,65,73,
57,68,82,41,49,67,13,22,35,56,66,73,
90,101,104,102,111,109,105,112,110,107,111,110,
64,78,93,62,73,88,73,82,95,85,88,105,
94,96,112,85,90,98,74,79,79,42,45,45,
48,51,54,78,84,85,45,55,59,226,240,249,
221,242,254,229,249,3,239,0,10,250,9,18,
8,23,32,24,38,45,73,87,91,94,107,108,
89,103,106,91,104,109,94,105,111,88,97,104,
92,99,108,83,90,100,67,74,83,93,101,108,
90,98,105,92,101,104,103,110,113,106,112,113,
241,1,23,239,253,18,241,253,12,253,2,22,
9,16,36,41,53,64,62,72,76,61,70,75,
79,90,97,87,101,105,29,43,54,182,199,220,
173,198,219,177,201,219,181,201,218,194,212,226,
230,242,0,30,39,50,92,98,104,105,110,112,
104,108,112,98,102,108,94,99,104,78,82,88,
73,79,83,82,89,91,83,90,94,70,77,85,
50,57,67,59,68,76,82,92,98,92,102,105,
189,209,236,197,214,242,191,207,228,196,213,230,
251,12,26,10,26,35,22,28,35,66,71,78,
85,99,105,77,94,99,34,51,61,231,249,9,
223,240,2,229,245,6,9,22,39,52,63,78,
78,83,94,92,93,103,90,90,98,76,74,83,
54,57,66,29,37,45,18,25,34,2,9,18,
253,4,11,1,10,15,7,17,23,4,13,22,
0,8,18,9,24,31,53,68,74,68,83,87,
168,181,205,186,198,222,213,226,244,255,15,24,
3,22,27,224,235,238,247,243,246,34,29,32,
44,51,53,55,65,68,53,65,69,52,64,71,
54,65,73,69,80,88,89,99,107,71,81,88,
45,52,57,30,36,43,16,21,30,3,7,20,
244,253,9,226,239,251,222,234,246,227,239,251,
233,246,0,235,249,1,250,6,16,9,22,32,
21,35,45,28,45,55,59,77,84,56,74,79,
141,143,163,154,157,175,5,11,22,77,87,91,
9,21,21,246,251,251,12,4,5,43,33,33,
52,52,51,78,80,82,91,95,96,99,105,104,
95,105,103,101,112,111,97,109,109,47,60,61,
15,30,34,9,25,33,13,29,41,16,34,48,
25,42,58,20,36,53,20,36,53,25,42,58,
28,45,60,31,48,62,44,61,75,58,75,88,
61,78,89,49,67,79,36,54,64,28,46,54,
133,133,152,186,190,207,71,78,88,96,103,110,
68,76,83,70,78,82,83,83,89,97,95,100,
100,101,108,104,107,117,103,109,116,101,109,110,
80,92,91,94,109,110,92,109,112,81,99,105,
69,88,99,51,71,85,64,87,101,59,84,100,
60,83,102,65,85,105,63,83,103,55,75,95,
43,64,83,42,62,80,32,52,68,15,36,50,
7,27,40,2,17,32,0,14,29,9,25,36,
167,173,199,16,26,50,61,75,93,57,67,87,
55,68,88,63,82,100,65,82,101,65,79,98,
65,77,98,62,74,99,63,78,99,61,78,92,
48,64,78,51,69,86,25,47,64,18,40,59,
16,32,55,27,42,66,17,34,57,241,4,27,
242,8,32,3,28,51,254,21,44,239,6,29,
220,243,9,219,240,6,221,242,4,222,244,2,
233,253,11,249,4,22,0,12,29,0,13,27,
250,6,32,33,50,78,14,31,65,8,25,60,
2,23,58,0,23,61,255,21,63,1,21,64,
2,21,63,0,18,61,255,18,60,0,20,60,
0,20,59,252,16,57,232,254,34,228,250,25,
230,248,25,246,5,41,240,0,34,222,237,16,
222,240,19,222,245,24,215,240,15,211,231,7,
208,225,1,211,231,5,221,239,10,229,245,12,
236,249,15,243,253,17,249,4,19,1,15,27,
201,215,237,204,218,241,205,218,250,208,221,255,
212,226,5,215,230,13,215,230,18,218,233,21,
222,239,23,230,247,31,235,252,36,241,2,43,
243,8,52,246,7,57,246,3,51,248,4,46,
243,7,43,238,4,39,234,255,34,228,247,26,
223,237,19,213,229,10,207,225,3,208,220,255,
208,222,0,205,228,4,208,228,0,210,226,250,
220,232,254,241,247,9,253,6,17,7,20,27,
141,153,169,131,139,153,137,144,163,146,154,176,
146,154,180,149,153,184,148,153,186,150,158,189,
154,164,190,162,171,198,170,179,205,176,187,215,
180,197,234,188,203,249,194,205,254,198,207,254,
199,215,255,200,216,254,195,209,248,188,200,240,
183,195,234,181,196,232,181,197,231,185,197,230,
185,199,233,185,206,238,200,217,243,215,228,247,
232,241,0,248,252,7,1,7,12,8,17,20,
164,174,183,139,144,148,136,141,147,160,172,181,
164,173,186,150,153,169,136,139,158,131,136,152,
129,132,145,128,130,143,128,130,143,128,132,148,
134,141,170,133,146,184,129,147,188,131,151,190,
141,157,199,152,166,209,149,161,205,149,159,204,
149,166,206,150,172,207,158,178,211,167,186,218,
185,198,229,213,218,246,241,243,9,251,251,9,
244,243,253,250,251,0,5,10,8,24,31,29,
163,169,173,154,155,154,141,147,146,155,169,169,
199,209,212,198,198,204,177,178,185,155,159,165,
143,143,149,133,133,139,130,130,135,128,128,135,
145,145,163,185,192,219,159,178,206,138,164,190,
132,158,188,132,158,190,135,158,191,142,163,197,
153,171,202,169,183,211,190,199,227,214,225,251,
250,252,17,15,2,20,3,248,6,242,233,242,
245,239,244,3,5,4,17,23,17,43,50,46,
144,143,145,141,138,137,132,138,136,131,140,139,
173,172,174,193,180,185,182,171,175,164,161,163,
146,146,148,132,132,135,130,130,132,128,129,131,
135,136,143,246,245,5,32,29,50,2,0,19,
240,240,2,233,233,253,233,231,252,237,233,255,
246,235,254,9,243,4,25,254,15,22,254,12,
255,234,244,233,214,219,234,222,225,248,244,244,
0,1,0,13,18,15,35,43,36,55,65,61,
168,168,163,140,138,135,128,131,131,128,132,132,
140,134,135,158,140,145,160,140,145,149,138,140,
135,134,135,130,129,131,130,129,130,131,130,131,
128,128,130,196,186,192,53,0,17,76,1,19,
67,255,15,65,251,12,66,247,8,58,241,0,
43,238,250,21,224,234,251,203,211,231,194,197,
223,199,198,232,221,216,250,246,241,0,3,254,
3,12,6,23,33,29,42,53,47,56,68,65,
197,205,192,154,157,149,129,129,129,129,129,130,
132,129,128,140,130,133,146,131,137,140,130,133,
132,129,130,130,128,128,130,128,128,132,128,129,
129,129,129,160,140,139,24,173,187,74,175,196,
66,174,195,62,176,197,50,178,195,26,177,187,
247,170,177,219,166,170,209,176,174,222,205,199,
245,238,230,253,254,244,253,0,248,0,6,0,
15,24,18,33,47,42,44,58,54,55,69,67,
211,222,210,175,180,171,129,129,129,130,129,130,
130,128,128,133,129,130,135,129,133,132,128,130,
129,128,128,129,128,128,129,128,128,131,128,128,
129,130,128,155,131,130,13,153,166,76,160,182,
69,153,174,40,153,171,249,153,164,213,157,162,
202,169,167,213,194,184,230,220,210,249,241,233,
0,252,243,250,254,243,249,255,246,3,10,2,
18,28,21,36,50,45,47,62,58,57,72,70,
220,230,221,182,188,178,134,135,131,131,130,129,
130,130,128,129,131,129,129,131,131,129,130,130,
129,129,129,129,128,128,129,128,128,129,129,129,
128,131,130,143,129,128,230,147,156,28,159,175,
245,145,151,202,141,140,184,155,150,202,186,183,
227,218,209,243,243,227,250,254,239,252,252,240,
251,251,241,253,1,247,0,6,254,7,16,8,
19,30,22,33,47,42,48,63,59,59,73,72,
215,227,217,171,179,165,147,151,139,139,140,132,
136,138,130,133,139,132,130,138,132,130,135,130,
131,132,129,131,132,129,131,132,129,130,131,130,
128,134,134,132,133,130,170,141,141,199,149,152,
181,155,153,185,178,169,208,205,190,241,226,210,
3,241,229,5,254,241,251,254,240,244,253,239,
248,0,243,2,9,254,10,19,8,14,25,16,
27,39,32,40,55,50,53,68,64,59,73,72,
210,224,210,174,185,164,164,172,150,159,163,145,
155,158,143,150,156,143,145,154,141,144,151,140,
146,149,140,147,149,141,148,150,142,147,151,143,
147,155,148,151,159,149,165,168,155,192,183,173,
215,198,195,232,216,209,244,230,213,0,240,216,
10,249,233,2,250,238,245,250,235,243,255,240,
251,4,247,2,10,255,10,20,9,19,31,22,
30,43,35,45,60,54,56,71,67,58,73,71,
213,229,211,190,203,176,186,195,166,183,189,165,
179,184,163,175,181,161,174,181,162,176,183,166,
177,183,168,179,184,169,181,186,172,183,190,174,
187,195,173,196,199,176,209,212,187,232,224,202,
244,231,211,255,237,220,4,244,225,255,249,225,
255,255,235,246,252,234,242,253,236,250,2,245,
0,7,251,7,16,4,12,23,12,20,33,24,
29,42,34,39,54,49,51,66,62,57,71,70
};
const int g_test_len = 3072;
const int g_test_ilabel = 8;
```

## src/main_functions.cpp
```c
/*
 * Copyright 2020 The TensorFlow Authors. All Rights Reserved.
 *
 * Licensed under the Apache License, Version 2.0 (the "License");
 * you may not use this file except in compliance with the License.
 * You may obtain a copy of the License at
 *
 *     http://www.apache.org/licenses/LICENSE-2.0
 *
 * Unless required by applicable law or agreed to in writing, software
 * distributed under the License is distributed on an "AS IS" BASIS,
 * WITHOUT WARRANTIES OR CONDITIONS OF ANY KIND, either express or implied.
 * See the License for the specific language governing permissions and
 * limitations under the License.
 */

/*
 * Copyright 2020 The TensorFlow Authors. All Rights Reserved.
 *
 * Licensed under the Apache License, Version 2.0 (the "License");
 * you may not use this file except in compliance with the License.
 * You may obtain a copy of the License at
 *
 *     http://www.apache.org/licenses/LICENSE-2.0
 *
 * Unless required by applicable law or agreed to in writing, software
 * distributed under the License is distributed on an "AS IS" BASIS,
 * WITHOUT WARRANTIES OR CONDITIONS OF ANY KIND, either express or implied.
 * See the License for the specific language governing permissions and
 * limitations under the License.
 */

#include "main_functions.h"
#include <tensorflow/lite/micro/micro_mutable_op_resolver.h>
#include "model.hpp"
#include "input.hpp"
#include <tensorflow/lite/micro/tflite_bridge/micro_error_reporter.h>
#include <tensorflow/lite/micro/micro_interpreter.h>
#include <tensorflow/lite/micro/system_setup.h>
#include <tensorflow/lite/schema/schema_generated.h>

namespace
{
	tflite::ErrorReporter *error_reporter = nullptr;
	const tflite::Model *model = nullptr;
	tflite::MicroInterpreter *interpreter = nullptr;
	TfLiteTensor *input = nullptr;
	TfLiteTensor *output = nullptr;

	constexpr int tensor_arena_size = 52000;
	uint8_t *tensor_arena = nullptr;
	tflite::MicroMutableOpResolver<5> resolver;

	static const char *label[] = {"airplane", "automobile", "bird", "cat", "deer",
								  "dog", "frog", "horse", "ship", "truck"};
	float o_scale = 0.0f;
	int32_t o_zero_point = 0;
}

void setup(void)
{
	static tflite::MicroErrorReporter micro_error_reporter;

	error_reporter = &micro_error_reporter;

	tensor_arena = (uint8_t *)malloc(tensor_arena_size);

	model = tflite::GetModel(cifar10_tflite);
	if (model->version() != TFLITE_SCHEMA_VERSION)
	{
		printf("Error loading the TFLite model\n");
		while (1)
			;
	}

	resolver.AddFullyConnected();
	resolver.AddDepthwiseConv2D();
	resolver.AddConv2D();
	resolver.AddMaxPool2D();
	resolver.AddReshape();

	static tflite::MicroInterpreter static_interpreter(
		model, resolver, tensor_arena, tensor_arena_size);

	interpreter = &static_interpreter;

	TfLiteStatus allocate_status = interpreter->AllocateTensors();
	if (allocate_status != kTfLiteOk)
	{
		printf("Error allocating the tensors\n");
		while (1)
			;
	}

	input = interpreter->input(0);
	output = interpreter->output(0);

	const auto *o_quantization = reinterpret_cast<TfLiteAffineQuantization *>(output->quantization.params);
	o_scale = o_quantization->scale->data[0];
	o_zero_point = o_quantization->zero_point->data[0];
}

void loop(void)
{
	for (int i = 0; i < g_test_len; i++)
	{
		input->data.int8[i] = g_test[i];
	}

	TfLiteStatus invoke_status = interpreter->Invoke();
	if (invoke_status != kTfLiteOk)
	{
		printf("Error running model inference\n");
		while (1)
			;
	}

	size_t ix_max = 0;
	float pb_max = 0;
	for (size_t ix = 0; ix < 10; ix++)
	{
		int8_t out_val = output->data.int8[ix];
		float pb = ((float)out_val - o_zero_point) * o_scale;
		if (pb > pb_max)
		{
			ix_max = ix;
			pb_max = pb;
		}
	}

	if (ix_max == g_test_ilabel)
	{
		printf("CORRECT classification! %s\n", label[ix_max]);
		while (1);
	}
	else
	{
		printf("WRONG classification! %s\n", label[ix_max]);
	}
}
```
